#include "splitty.dtsi"
		
&kscan0 {
		
		
	col-gpios = <&gpio0 10 GPIO_ACTIVE_HIGH>,
				<&gpio0 11 GPIO_ACTIVE_HIGH>,
				<&gpio0 12 GPIO_ACTIVE_HIGH>,
				<&gpio0 16 GPIO_ACTIVE_HIGH>,
				<&gpio0 15 GPIO_ACTIVE_HIGH>,
				<&gpio0 14 GPIO_ACTIVE_HIGH>,
				<&gpio0 13 GPIO_ACTIVE_HIGH>;
};